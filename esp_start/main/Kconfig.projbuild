## esp_start/main/Kconfig.projbuild
```kconfig
menu "DesktopScreen Configuration"

    # i2c master
    menu "I2C Master"
        config I2C_MASTER_SCL
            int "SCL GPIO Num"
            default 32
            help
                GPIO number for I2C Master clock line.

        config I2C_MASTER_SDA
            int "SDA GPIO Num"
            default 33
            help
                GPIO number for I2C Master data line.

        config I2C_MASTER_PORT_NUM
            int "Port Number"
            default 1
            help
                Port number for I2C Master device.

        config I2C_MASTER_FREQUENCY
            int "Master Frequency"
            default 100000
            help
                I2C Speed of Master device.
    endmenu

    # wifi access point
    menu "Wifi AP"

        config ESP_AP_WIFI_SSID
            string "WiFi SSID"
            default "zhcode_screen"
            help
                SSID (network name).
    
        config ESP_AP_WIFI_PASSWORD
            string "WiFi Password"
            default "zhcode123"
            help
                WiFi password (WPA or WPA2).
        config ESP_AP_WIFI_CHANNEL
            int "WiFi Channel"
            range 1 13
            default 1
            help
                WiFi channel (network channel).
    
        config ESP_AP_MAX_STA_CONN
            int "Maximal STA connections"
            default 4
            help
                Max number of the STA connects to AP.
    endmenu
    
    # wifi station
    menu "Wifi Station"

        config ESP_WIFI_SSID
            string "WiFi SSID"
            default "zhcode"
            help
                SSID (network name) for the example to connect to.
    
        config ESP_WIFI_PASSWORD
            string "WiFi Password"
            default "zhcode123"
            help
                WiFi password (WPA or WPA2) for the example to use.
    
        config ESP_MAXIMUM_RETRY
            int "Maximum retry"
            default 5
            help
                Set the Maximum retry to avoid station reconnecting to the AP unlimited when the AP is really inexistent.
    
        choice ESP_WIFI_SCAN_AUTH_MODE_THRESHOLD
            prompt "WiFi Scan auth mode threshold"
            default ESP_WIFI_AUTH_OPEN
            help
                The weakest authmode to accept in the scan mode.
    
            config ESP_WIFI_AUTH_OPEN
                bool "OPEN"
            config ESP_WIFI_AUTH_WEP
                bool "WEP"
            config ESP_WIFI_AUTH_WPA_PSK
                bool "WPA PSK"
            config ESP_WIFI_AUTH_WPA2_PSK
                bool "WPA2 PSK"
            config ESP_WIFI_AUTH_WPA_WPA2_PSK
                bool "WPA/WPA2 PSK"
            config ESP_WIFI_AUTH_WPA3_PSK
                bool "WPA3 PSK"
            config ESP_WIFI_AUTH_WPA2_WPA3_PSK
                bool "WPA2/WPA3 PSK"
            config ESP_WIFI_AUTH_WAPI_PSK
                bool "WAPI PSK"
        endchoice
    
    endmenu
    
    # wifi scan
    menu "Wifi Scan"
        config SCAN_LIST_SIZE
            int "Max size of scan list"
            range 0 20
            default 10
            help
                The size of array that will be used to retrieve the list of access points.

        config DS_TEST
            int "Desktop Screen test list"
            range 0 20
            default 10
            help
                Desktop Screen test in Kconfig.
    endmenu

    # u8g2
    menu "u8g2"
        config u8g2_ENABLE
            bool "Enable u8g2"
            default "y"
            help
                Whether enable u8g2 component.
    endmenu
endmenu
```
